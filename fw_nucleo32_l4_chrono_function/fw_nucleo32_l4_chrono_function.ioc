# file: fw_nucleo32_l4_chrono_function.ioc
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Mcu.Family=STM32L4
Mcu.Name=STM32L432K(B-C)Ux
Mcu.Package=UFQFPN32
NVIC.PriorityGroup=NVIC_PRIORITYGROUP_4
NVIC.TIM1_UP_TIM16_IRQn=true\:0\:0\:false\:false\:true\:true\:true\:true
PB3\ (JTDO-TRACESWO).Signal=GPIO_Output
ProjectManager.HeapSize=0x200
ProjectManager.StackSize=0x400
ProjectManager.TargetToolchain=MDK-ARM V5.32
RCC.AHBFreq_Value=80000000
RCC.APB1Freq_Value=80000000
RCC.APB1TimFreq_Value=80000000
RCC.APB2Freq_Value=80000000
RCC.APB2TimFreq_Value=80000000
RCC.CortexFreq_Value=80000000
RCC.HCLKFreq_Value=80000000
RCC.HSE_VALUE=8000000
RCC.HSI48_VALUE=48000000
RCC.HSI_VALUE=16000000
RCC.LSE_VALUE=32768
RCC.MSI_VALUE=4000000
RCC.PLLN=40
RCC.SYSCLKFreq_VALUE=80000000
RCC.SYSCLKSource=RCC_SYSCLKSOURCE_PLLCLK
RCC.VCOOutputFreq_Value=160000000
TIM1.Prescaler=79
VP_TIM1_VS_ClockSourceINT.Mode=Internal
board=custom

// file: Core/Src/main.c
/* USER CODE BEGIN Header */
/**
  ******************************************************************************
  * @file           : main.c
  * @brief          : Main program body
  ******************************************************************************
  * @attention
  *
  * Copyright (c) 2024 STMicroelectronics.
  * All rights reserved.
  *
  * This software is licensed under terms that can be found in the LICENSE file
  * in the root directory of this software component.
  * If no LICENSE file comes with this software, it is provided AS-IS.
  *
  ******************************************************************************
  */
/* USER CODE END Header */
#include "main.h"
#include "tim.h"
#include "gpio.h"

/* USER CODE BEGIN Includes */
#include "..\..\chrono\chrono.h"
#include <stdio.h>

/* USER CODE END Includes */

/* USER CODE BEGIN PM */
#define LED_ON_()			HAL_GPIO_WritePin(GPIOB, GPIO_PIN_3, GPIO_PIN_SET)
#define LED_OFF_()		HAL_GPIO_WritePin(GPIOB, GPIO_PIN_3, GPIO_PIN_RESET)
#define LED_TOGGLE_()	HAL_GPIO_TogglePin(GPIOB, GPIO_PIN_3)

/* USER CODE END PM */

/* USER CODE BEGIN PV */
static sChrono chronoTimeout;
static sChrono chronoInterval;
static sChrono chronoElapsed;

extern uint32_t tickValueMSB;

/* USER CODE END PV */

void SystemClock_Config(void);
/* USER CODE BEGIN PFP */
uint32_t ChronoGetTick(void) {

	return (uint32_t)((tickValueMSB << 16) + (TIM1->CNT));
}

/* USER CODE END PFP */

int main(void)
{

  /* MCU Configuration--------------------------------------------------------*/

  /* Reset of all peripherals, Initializes the Flash interface and the Systick. */
  HAL_Init();

  /* Configure the system clock */
  SystemClock_Config();

  /* Initialize all configured peripherals */
  MX_GPIO_Init();
  MX_TIM1_Init();
  /* USER CODE BEGIN 2 */
	HAL_TIM_Base_Start_IT(&htim1);

	// Initialize chrono module:
	// Each tick is 1 microseconds and time counts from 0 to 0xFFFF, but each time the timer overflows,
	// tickValueMSB is incremented. ChronoGetTick() returns ticks from 0 to 0xFFFFFFFE, so tick top value is 0xFFFFFFFF.
	fChrono_Init(ChronoGetTick);

	LED_OFF_();

	//Start chronoTimeout object with timeout parameter 5000.
	//Unit of timeout is specified by calling fChrono_IsTimeoutS(), fChrono_IsTimeoutMs() or fChrono_IsTimeoutUs().
	fChrono_StartTimeoutMs(&chronoTimeout, 5000);

	//Start chronoInterval object.
	fChrono_Start(&chronoInterval);

  /* USER CODE END 2 */

  /* Infinite loop */
  while (1)
  {

    /* USER CODE BEGIN 3 */

		//Measure while(1) interval in microseconds.
		timeUs_t interval = fChrono_IntervalUs(&chronoInterval);
		printf("Interval: %u us.\n", interval);

		//Start chronoElapsed object.
		//MEASUREMENT TAG: A
		fChrono_Start(&chronoElapsed);

		//Check whether chronoTimeout is timeout or not.
		if(fChrono_IsTimeout(&chronoTimeout) == true) {
			printf("chrono is timed out.\n");
		} else {
			printf("chrono is not timed out.\n");
		}

		//Create a time delay of 500 milliseconds.
		fChrono_DelayMs(500);
		LED_TOGGLE_();

		//MEASUREMENT TAG: B
		//Measure time between (MEASUREMENT TAG: A) and (MEASUREMENT TAG: B) in microseconds.
		timeUs_t elapsed = fChrono_ElapsedUs(&chronoElapsed);
		printf("elapsed: %u us.\n", elapsed);

  }
  /* USER CODE END 3 */
}

void SystemClock_Config(void)
{
  RCC_OscInitTypeDef RCC_OscInitStruct = {0};
  RCC_ClkInitTypeDef RCC_ClkInitStruct = {0};

  /** Configure the main internal regulator output voltage
  */
  if (HAL_PWREx_ControlVoltageScaling(PWR_REGULATOR_VOLTAGE_SCALE1) != HAL_OK)
  {
    Error_Handler();
  }

  /** Initializes the RCC Oscillators according to the specified parameters
  * in the RCC_OscInitTypeDef structure.
  */
  RCC_OscInitStruct.OscillatorType = RCC_OSCILLATORTYPE_MSI;
  RCC_OscInitStruct.MSIState = RCC_MSI_ON;
  RCC_OscInitStruct.MSICalibrationValue = 0;
  RCC_OscInitStruct.MSIClockRange = RCC_MSIRANGE_6;
  RCC_OscInitStruct.PLL.PLLState = RCC_PLL_ON;
  RCC_OscInitStruct.PLL.PLLSource = RCC_PLLSOURCE_MSI;
  RCC_OscInitStruct.PLL.PLLM = 1;
  RCC_OscInitStruct.PLL.PLLN = 40;
  RCC_OscInitStruct.PLL.PLLP = RCC_PLLP_DIV7;
  RCC_OscInitStruct.PLL.PLLQ = RCC_PLLQ_DIV2;
  RCC_OscInitStruct.PLL.PLLR = RCC_PLLR_DIV2;
  if (HAL_RCC_OscConfig(&RCC_OscInitStruct) != HAL_OK)
  {
    Error_Handler();
  }

  /** Initializes the CPU, AHB and APB buses clocks
  */
  RCC_ClkInitStruct.ClockType = RCC_CLOCKTYPE_HCLK|RCC_CLOCKTYPE_SYSCLK
                              |RCC_CLOCKTYPE_PCLK1|RCC_CLOCKTYPE_PCLK2;
  RCC_ClkInitStruct.SYSCLKSource = RCC_SYSCLKSOURCE_PLLCLK;
  RCC_ClkInitStruct.AHBCLKDivider = RCC_SYSCLK_DIV1;
  RCC_ClkInitStruct.APB1CLKDivider = RCC_HCLK_DIV1;
  RCC_ClkInitStruct.APB2CLKDivider = RCC_HCLK_DIV1;

  if (HAL_RCC_ClockConfig(&RCC_ClkInitStruct, FLASH_LATENCY_4) != HAL_OK)
  {
    Error_Handler();
  }
}

void Error_Handler(void)
{
  __disable_irq();
  while (1)
  {
  }
}
